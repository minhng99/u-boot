## arch/arm/mach-realtek/Kconfig
```kconfig
# SPDX-License-Identifier: GPL-2.0+
if ARCH_REALTEK

config TARGET_BANANAPI_W2
	bool "Banana Pi BPI-W2"
	default y
	select DM_GPIO
	select GPIO_RTD1296

config SYS_SOC
	default "rtd1296"

config TEXT_BASE
	default 0x00200000

config SYS_MALLOC_F_LEN
	default 0x4000

source "board/bananapi/bpi-w2/Kconfig"

endif
```

## board/bananapi/bpi-w2/Kconfig
```kconfig
# SPDX-License-Identifier: GPL-2.0+
if TARGET_BANANAPI_W2

config SYS_BOARD
	default "bpi-w2"

config SYS_VENDOR
	default "bananapi"

config SYS_CONFIG_NAME
	default "bananapi_w2"

endif
```

## configs/bananapi_w2_defconfig
```kconfig
CONFIG_ARM=y
CONFIG_SKIP_LOWLEVEL_INIT=y
CONFIG_SYS_HAS_NONCACHED_MEMORY=y
CONFIG_ARCH_REALTEK=y
CONFIG_SYS_MALLOC_LEN=0x1000000
CONFIG_NR_DRAM_BANKS=1
CONFIG_HAS_CUSTOM_SYS_INIT_SP_ADDR=y
CONFIG_CUSTOM_SYS_INIT_SP_ADDR=0x08000000
CONFIG_ENV_SIZE=0x4000
CONFIG_DEFAULT_DEVICE_TREE="rtd1296-bananapi-bpi-w2"
CONFIG_SYS_LOAD_ADDR=0x02000000
CONFIG_DEBUG_UART_BASE=0x98007800
CONFIG_DEBUG_UART_CLOCK=27000000
CONFIG_PCI=y
CONFIG_DEBUG_UART=y
# CONFIG_EFI_LOADER is not set
CONFIG_SUPPORT_RAW_INITRD=y
CONFIG_BOOTDELAY=-1
CONFIG_OF_BOARD_SETUP=y
# CONFIG_DISPLAY_CPUINFO is not set
CONFIG_HUSH_PARSER=y
CONFIG_CMD_NVEDIT_INFO=y
CONFIG_CMD_NVEDIT_LOAD=y
CONFIG_CMD_BIND=y
CONFIG_CMD_GPIO=y
CONFIG_CMD_MMC=y
CONFIG_CMD_MTD=y
CONFIG_CMD_PART=y
CONFIG_CMD_PCI=y
CONFIG_CMD_POWEROFF=y
CONFIG_CMD_SF_TEST=y
CONFIG_CMD_USB=y
CONFIG_CMD_TFTPPUT=y
CONFIG_CMD_DHCP=y
CONFIG_CMD_MII=y
CONFIG_CMD_PING=y
CONFIG_CMD_CACHE=y
CONFIG_CMD_HASH=y
CONFIG_CMD_UBI=y
CONFIG_EFI_PARTITION=y
CONFIG_ENV_IS_IN_UBI=y
CONFIG_ENV_REDUNDANT=y
CONFIG_ENV_UBI_PART="ubi_env"
CONFIG_ENV_UBI_VOLUME="env_a"
CONFIG_ENV_UBI_VOLUME_REDUND="env_b"
CONFIG_ENV_UBI_VOLUME_CREATE=y
CONFIG_NET_RANDOM_ETHADDR=y
CONFIG_SATA_RTD1296=y
CONFIG_LED=y
CONFIG_LED_GPIO=y
CONFIG_MMC_DW_RTD1296=y
CONFIG_MMC_RTD1296_SD=y
CONFIG_MTD=y
CONFIG_DM_MTD=y
CONFIG_DM_SPI_FLASH=y
CONFIG_SPI_FLASH_SFDP_SUPPORT=y
# CONFIG_SPI_FLASH_UNLOCK_ALL is not set
CONFIG_SPI_FLASH_WINBOND=y
# CONFIG_SPI_FLASH_USE_4K_SECTORS is not set
CONFIG_SPI_FLASH_MTD=y
CONFIG_RTD1296_ETH=y
CONFIG_NVME_RTD1296=y
CONFIG_PCIE_RTD1296=y
# CONFIG_PCI_PNP is not set
CONFIG_PINCTRL=y
CONFIG_PINCTRL_SINGLE=y
CONFIG_DM_REGULATOR_FIXED=y
CONFIG_RESET_SYSCON=y
CONFIG_DEBUG_UART_SHIFT=2
CONFIG_SYS_NS16550=y
CONFIG_SYS_NS16550_MEM32=y
CONFIG_SPI=y
CONFIG_SPI_RTD1296=y
CONFIG_DM_SPI=y
CONFIG_SYSRESET=y
CONFIG_SYSRESET_CMD_POWEROFF=y
CONFIG_SYSRESET_PSCI=y
CONFIG_USB=y
CONFIG_USB_RTD1296=y
CONFIG_USB_STORAGE=y
CONFIG_SHA256=y
```

## drivers/nvme/Kconfig
```kconfig
# SPDX-License-Identifier: GPL-2.0+
#
# Copyright (C) 2017, Bin Meng <bmeng.cn@gmail.com>

config NVME
	bool "NVM Express device support"
	select BLK
	help
	  This option enables support for NVM Express devices.
	  It supports basic functions of NVMe (read/write).

config NVME_RTD1296
	bool "NVMe devices on RTD1296 PCIe links"
	depends on PCIE_RTD1296 && !NVME_PCI
	select NVME
	help
	  Use the common NVMe command engine with banked PCIe doorbell
	  access on RTD1296 hosts.

config NVME_APPLE
	bool "Apple NVMe controller support"
	depends on ARCH_APPLE
	select NVME
	help
	  This option enables support for the NVMe storage
	  controller integrated on Apple SoCs.  This controller
	  isn't PCI-based based and deviates from the NVMe
	  standard implementation in its implementation of
	  the command submission queue and the integration
	  of an NVMMU that needs to be managed.

config NVME_PCI
	bool "NVM Express PCI device support"
	depends on PCI
	select NVME
	help
	  This option enables support for NVM Express PCI
	  devices.
```
